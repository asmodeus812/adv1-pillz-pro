## Kconfig.defconfig
```kconfig
# Copyright (c) 2020 The ZMK Contributors
# SPDX-License-Identifier: MIT

if SHIELD_PILLZMOD

config ZMK_KEYBOARD_NAME
    default "Pillz Mod"

endif
```

## config/boards/shields/pillzmod_pro/Kconfig.defconfig
```kconfig
# Copyright (c) 2020 The ZMK Contributors
# SPDX-License-Identifier: MIT

if SHIELD_PILLZMOD_PRO

config ZMK_KEYBOARD_NAME
    default "Advantage 1"

config SPI
    default y

endif
```
