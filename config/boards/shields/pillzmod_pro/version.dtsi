#define VERSION_MACRO
macro_ver: macro_ver {
compatible = "zmk,behavior-macro";
label = "macro_ver";
#binding-cells = <0>;
bindings = <&kp N2>, <&kp N0>, <&kp N2>, <&kp N5>, <&kp N0>, <&kp N2>, <&kp N1>, <&kp N3>, <&kp MINUS>, <&kp M>, <&kp A>, <&kp I>, <&kp N>, <&kp MINUS>, <&kp E>, <&kp A>, <&kp N1>, <&kp B>, <&kp N8>, <&kp N2>, <&kp D>, <&kp RET>;
};
